## config/west.yml
```yaml
manifest:
  remotes:
    - name: zmkfirmware
      url-base: https://github.com/zmkfirmware
    - name: ergohaven
      url-base: https://github.com/ergohaven
    - name: sergei
      url-base: https://github.com/sergejkaravajnij
  projects:
    - name: zmk
      remote: zmkfirmware
      revision: abb64ba316c29caddc49727ca2cac2f0ed5970c7
      import: app/west.yml
    - name: zmk-pmw3610-driver
      remote: ergohaven
      revision: eh
    - name: ergohaven-zmk-qube
      remote: sergei
      revision: sk
    - name: zmk-raw-hid
      remote: ergohaven
      revision: main
  self:
    path: config
```
